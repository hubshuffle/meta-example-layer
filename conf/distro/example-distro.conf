## conf/distro/example-distro.conf
```bitbake
MAINTAINER = "hubshuffle <hubshuffled@gmail.com>"

require conf/distro/poky.conf

DISTRO = "example-distro"
DISTRO_NAME = "example distro"
DISTRO_VERSION = "1.0"
DISTRO_CODENAME = "codename"
SDK_VENDOR = "-exampledistro"
SDK_VERSION := "${@'${DISTRO_VERSION}'.replace('snapshot-${DATE}', 'snapshot')}"

# Replace sysv with systemd
DISTRO_FEATURES += "systemd wifi"
VIRTUAL-RUNTIME_init_manager = "systemd"
DISTRO_FEATURES_remove += " sysvinit bluetooth pcmcia wayland pulseaudio bluez5 pci ext2 irda x11 nfc opengl ptest 3g"
VIRTUAL-RUNTIME_initscripts = "systemd-compat-units"
DISTRO_FEATURES_BACKFILL_CONSIDERED += "sysvinit"

# Configure package management
EXTRA_IMAGE_FEATURES_append = " package-management"
PACKAGE_CLASSES = "package_ipk"
IMAGE_INSTALL_append = " opkg"
PRSERV_HOST = "localhost:0"
PACKAGE_FEED_URIS = "http://192.168.77.1:8080"
PACKAGE_FEED_BASE_PATHS = ""
PACKAGE_FEED_ARCHS = "cortexa7t2hf-neon-vfpv4"

# Set hostname
hostname_pn-base-files = "hubshuffle"

# Set locale
GLIBC_GENERATE_LOCALES = "en_GB.UTF-8 en_US.UTF-8"
IMAGE_LINGUAS = "en-gb en-us"

# Set default timezone
DEFAULT_TIMEZONE = "Europe/London"
```

## conf/layer.conf
```bitbake
# We have a conf and classes directory, add to BBPATH
BBPATH .= ":${LAYERDIR}"

# We have recipes-* directories, add to BBFILES
BBFILES += "${LAYERDIR}/recipes-*/*/*.bb \
            ${LAYERDIR}/recipes-*/*/*.bbappend"

BBFILE_COLLECTIONS += "meta-example-layer"
BBFILE_PATTERN_meta-example-layer = "^${LAYERDIR}/"
BBFILE_PRIORITY_meta-example-layer = "10"

LAYERDEPENDS_meta-example-layer = "core"
LAYERDEPENDS_meta-example-layer += "raspberrypi"
LAYERSERIES_COMPAT_meta-example-layer = "thud"
```

## conf/machine/raspberrypi3-custom.conf
```bitbake
#@TYPE: Machine
#@NAME: RaspberryPi 3 Development Board
#@DESCRIPTION: Machine configuration for the RaspberryPi 3

MACHINEOVERRIDES =. "raspberrypi3:${MACHINE}"

DEFAULTTUNE ?= "cortexa7thf-neon-vfpv4"
require conf/machine/include/tune-cortexa7.inc
require conf/machine/include/rpi-base.inc

MACHINE_EXTRA_RRECOMMENDS += "\
    linux-firmware-rpidistro-bcm43430 \
    linux-firmware-rpidistro-bcm43455 \
    bluez-firmware-rpidistro-bcm43430a1-hcd \
    bluez-firmware-rpidistro-bcm4345c0-hcd \
"
 
SDIMG_KERNELIMAGE ?= "kernel7.img"
SERIAL_CONSOLES ?= "115200;ttyS0"

ENABLE_UART = "1"
ENABLE_I2C = "1"
ENABLE_SPI_BUS = "1"
GPU_MEM = "256"
DISABLE_SPLASH = "1"
DISABLE_RPI_BOOT_LOGO = "1"

KERNEL_MODULE_AUTOLOAD += "i2c-dev"

# Use u-boot instead of barebox
#RPI_USE_U_BOOT = "1"
#KERNEL_IMAGETYPE = "zImage"
#KERNEL_BOOTCMD = "bootz"
```
